## west.yml
```yaml
manifest:
  projects:
    - name: zephyr
      url: https://github.com/zephyrproject-rtos/zephyr
      revision: 413b789deb391d3a37d06b463288a5fe765ee57e
      import:
        name-allowlist:
          - cmsis_6
          - hal_infineon
          - hal_espressif
          - mbedtls
          - hal_rpi_pico
          - lvgl

#    # WAMR is added as a separate project, not a module
#    - name: wasm-micro-runtime
#      url: https://github.com/bytecodealliance/wasm-micro-runtime
#      revision: main
#      import:
#        path: modules/wasm-micro-runtime
    
```
