## CMakeLists.txt
```
# SPDX-License-Identifier: Apache-2.0

cmake_minimum_required(VERSION 3.20.0)

find_package(Zephyr REQUIRED HINTS $ENV{ZEPHYR_BASE})
project(picow_uart)

target_sources(app PRIVATE src/main.c)
```

## prj.conf
```kconfig
#-------------------Required when using USB CDC---------------------
#CONFIG_USB_DEVICE_STACK=y
#CONFIG_USB_DEVICE_PRODUCT="RPi Pico USB Serial Console"
#CONFIG_USB_DEVICE_VID=0001

CONFIG_SERIAL=y # Enable options for serial drivers
#CONFIG_CONSOLE=y # Enables a console for use with USB CDC applications - maybe this can be disabled too
CONFIG_UART_CONSOLE=y # Sets the default for printk and printf to output to the UART serial console
CONFIG_UART_LINE_CTRL=y # This enables the API for apps to control the serial line, such as baud rate, CTS and RTS.
```

## app.overlay
```dts
/ {
    chosen {
        zephyr,console = &uart0;
    };
};

//Any changes to UART configuration must be done here, not to the board's .dtsi
  
&uart0 {
    status = "okay";
    pinctrl-0 = <&uart0_default>;
    pinctrl-names = "default";
    current-speed = <115200>;
};
```

## src/main.c
```c
#include <zephyr/kernel.h>
#include <zephyr/sys/printk.h>
#include <zephyr/sys/util.h>
#include <string.h>
//#include <zephyr/usb/usb_device.h> //no need for USB CDC since we are using UART pins
#include <zephyr/drivers/uart.h>

#define SLEEP_TIME_MS 1000


int main()
{
	//Initialize a UART device
	const struct device *uart_dev = DEVICE_DT_GET(DT_CHOSEN(zephyr_console));

	if(!device_is_ready(uart_dev)){
		printk("UART device is not ready!!\n");
		return 0;
	}
	
	int i = 1;
	bool option = true;
	char buff[1024];
	buff[0] = '\0';

	while(option){
		printf("%d - Hello from the Zephyr console on RPi Pico W\n", (i % 10));
		k_sleep(K_MSEC(SLEEP_TIME_MS));
		printf("Good job on getting your first Zephyr Project working...\n\n\n");
		k_sleep(K_MSEC(2*SLEEP_TIME_MS));
		i++;
	}

	while(!option){
		printf("%d - Wow, you really went through all that setup just so I could say: ", i%10); 
		k_sleep(K_MSEC(SLEEP_TIME_MS));
		printf("'Hello, Human!'\n");
		k_sleep(K_MSEC(SLEEP_TIME_MS));
		printf("Now go touch some grass, tech wizard!\n\n\n");
		k_sleep(K_MSEC(2*SLEEP_TIME_MS));
		i++;
	}
	return 0;
}
```
